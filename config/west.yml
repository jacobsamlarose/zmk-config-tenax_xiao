## config/west.yml
```yaml
manifest:
  remotes:
    - name: zmkfirmware
      url-base: https://github.com/zmkfirmware
    - name: mctechnology17
      url-base: https://github.com/mctechnology17
    - name: urob
      url-base: https://github.com/urob
    - name: caksoylar
      url-base: https://github.com/caksoylar
    - name: prospector
      url-base: https://github.com/t-ogura
  projects:
    - name: zmk
      remote: zmkfirmware
      revision: v0.3
      import: app/west.yml
    - name: zmk-smart-toggle
      remote: caksoylar
      revision: main
    - name: zmk-leader-key
      remote: urob
      revision: main      
    - name: prospector-zmk-module
      remote: prospector
      revision: v2.0.0 
      path: modules/prospector-zmk-module
  self:
    path: config
```
